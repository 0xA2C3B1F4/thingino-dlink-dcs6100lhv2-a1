## profiles/dlink-dcs6100lhv2-a1/defconfig
```kconfig
# NAME: D-Link DCS-6100LHV2 A1 (T31N, OS02G10, RTL8188FU)
# FRAG: soc-xburst1 core ssl
BR2_INGENIC_SOC_MODEL="t31n"
BR2_THINGINO_FLASH_NOR=y
FLASH_SIZE_MB=16
KERNEL_VERSION_3=y
# BR2_THINGINO_TOOLCHAIN_LIBC_UCLIBC is not set
BR2_THINGINO_TOOLCHAIN_LIBC_GLIBC=y
# BR2_THINGINO_TOOLCHAIN_LIBC_MUSL is not set

BR2_PACKAGE_WIFI=y
BR2_PACKAGE_WIFI_RTL8188FU=y
# BR2_PACKAGE_THINGINO_KOPT_IPV6 is not set
# BR2_PACKAGE_THINGINO_ODHCP6C is not set
BR2_PACKAGE_THINGINO_KOPT_MMC=y
BR2_PACKAGE_THINGINO_KOPT_MMC0=y
BR2_PACKAGE_THINGINO_KOPT_MMC0_PB_4BIT=y
BR2_THINGINO_SDCARD=y
BR2_SENSOR_1_NAME="os02g10"
BR2_SENSOR_1_PARAMS="reset_gpio=18 pwdn_gpio=-1 sensor_max_fps=25 shvflip=1"
BR2_THINGINO_RMEM_MB=22

BR2_AVPU_MPLL=y
BR2_AVPU_CLK_440MHZ=y
BR2_AVPU_PARAMS="avpu_codec_nr_devs=4"
BR2_ISP_CLK_125MHZ=y
BR2_ISP_MEMOPT_1=y
BR2_ISP_PRINT_LEVEL_1=y
BR2_ISP_DAY_NIGHT_SWITCH_DROP_FRAME=y
BR2_ISP_DAY_NIGHT_SWITCH_DROP_FRAME_NUM_VALUE=6
BR2_ISP_CH0_PRE_DEQUEUE_TIME=y
BR2_ISP_CH0_PRE_DEQUEUE_TIME_VALUE=14
BR2_ISP_CH0_PRE_DEQUEUE_INTERRUPT_PROCESS=y
BR2_ISP_CH0_PRE_DEQUEUE_INTERRUPT_PROCESS_VALUE=0
BR2_ISP_CH0_PRE_DEQUEUE_VALID_LINES=y
BR2_ISP_CH0_PRE_DEQUEUE_VALID_LINES_VALUE=540
BR2_ISP_CH1_DEQUEUE_DELAY_TIME=y
BR2_ISP_CH1_DEQUEUE_DELAY_TIME_VALUE=0

BR2_THINGINO_AUDIO=y
BR2_THINGINO_AUDIO_GPIO=-1
BR2_THINGINO_BUTTON=y
BR2_THINGINO_GPIO_LIST="49o,50o,52O,54O,57o,61o,63o"
BR2_THINGINO_LED_G_GPIO=52
BR2_THINGINO_LED_G_ACTIVE_LOW=y
BR2_THINGINO_LED_R_GPIO=54
BR2_THINGINO_LED_R_ACTIVE_LOW=y

BR2_LINUX_KERNEL_CONFIG_FRAGMENT_FILES="$(BR2_EXTERNAL_THINGINO_PATH)/configs/cameras-exp/dlink_dcs6100lhv2_a1_t31n_os02g10_rtl8188fu/kernel.fragment"
BR2_REPRODUCIBLE=y
# BR2_TARGET_ENABLE_ROOT_LOGIN is not set
BR2_STRIP_EXCLUDE_FILES="libimp.so libalog.so libsysutils.so"
# BR2_CCACHE is not set
# BR2_CCACHE_USE_BASEDIR is not set
# BR2_USE_CCACHE is not set

BR2_PACKAGE_THINGINO_HA=y
BR2_PACKAGE_THINGINO_MOSQUITTO_20X=y
BR2_PACKAGE_THINGINO_SYSTEM_SWAP=y
BR2_PACKAGE_PRUDYNT_T_AAC=y
BR2_PACKAGE_PRUDYNT_T_DCS6100_CAMERA_LOCAL_VENDOR=y
BR2_PACKAGE_PRUDYNT_T_OPUS=y
# BR2_PACKAGE_PRUDYNT_T_MP3 is not set
# BR2_PACKAGE_PRUDYNT_T_FLAC is not set
# BR2_PACKAGE_THINGINO_SOUNDS_STARTUP is not set
# BR2_PACKAGE_THINGINO_SOUNDS_CHIMES is not set
# BR2_PACKAGE_THINGINO_SYSUPGRADE is not set
# BR2_PACKAGE_THINGINO_MOSQUITTO_20X_BROKER is not set
# BR2_PACKAGE_THINGINO_MOSQUITTO_212 is not set
BR2_PACKAGE_THINGINO_VPN_NONE=y
# BR2_PACKAGE_THINGINO_AGENT is not set
BR2_PACKAGE_THINGINO_CONTROL=y
# BR2_PACKAGE_THINGINO_VPN_WIREGUARD is not set
# BR2_PACKAGE_THINGINO_VPN_ZEROTIER is not set
# BR2_PACKAGE_THINGINO_VPN_TAILSCALE is not set
# BR2_PACKAGE_ZEROTIER_ONE is not set
```
